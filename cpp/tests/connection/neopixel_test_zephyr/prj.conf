## CMakeLists.txt
```
cmake_minimum_required(VERSION 3.20)
find_package(Zephyr REQUIRED HINTS $ENV{ZEPHYR_BASE})
project(neopixel_test_zephyr)

set(CPP_DIR ${CMAKE_CURRENT_SOURCE_DIR}/../../..)

target_sources(app PRIVATE
    src/main.cpp
)

target_include_directories(app PRIVATE
    ${CPP_DIR}/src/connection
)
```

## prj.conf
```kconfig
CONFIG_SPI=y
CONFIG_CPP=y
CONFIG_STD_CPP17=y
CONFIG_NEWLIB_LIBC=y
CONFIG_FPU=y
```

## src/main.cpp
```c
#include <zephyr/kernel.h>
#include <zephyr/device.h>
#include <zephyr/devicetree.h>
#include "NeoPixelConnectionZephyr.h"

#ifndef NEOPIXEL_SPI_NODE
#define NEOPIXEL_SPI_NODE DT_NODELABEL(spi0)
#endif

static int passed = 0;
static int failed = 0;

static void check_true(bool cond, const char *label) {
    if (cond) { printk("PASS %s\n", label); passed++; }
    else       { printk("FAIL %s\n", label); failed++; }
}

int main(void) {
    const struct device *spi_dev = DEVICE_DT_GET(NEOPIXEL_SPI_NODE);
    NeoPixelConnectionZephyr connection(spi_dev);

    uint8_t data[3] = {0xFF, 0x00, 0x00};
    connection.write(data, 3);

    check_true(true, "write accepted data");

    printk("===DONE: %d passed, %d failed===\n", passed, failed);
    return failed == 0 ? 0 : 1;
}
```
