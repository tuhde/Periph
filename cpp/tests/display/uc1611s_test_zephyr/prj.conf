## CMakeLists.txt
```
cmake_minimum_required(VERSION 3.20)
find_package(Zephyr REQUIRED HINTS $ENV{ZEPHYR_BASE})
project(uc1611s_test)

set(CPP_DIR ${CMAKE_CURRENT_SOURCE_DIR}/../../..)

target_sources(app PRIVATE
    src/main.cpp
    ${CPP_DIR}/src/chips/display/UC1611s.cpp
)
target_include_directories(app PRIVATE
    ${CPP_DIR}/src/connection
    ${CPP_DIR}/src/chips/display
    ${CMAKE_CURRENT_SOURCE_DIR}/..
)
```

## prj.conf
```kconfig
CONFIG_I2C=y
CONFIG_CPP=y
CONFIG_STD_CPP17=y
CONFIG_NEWLIB_LIBC=y
CONFIG_FPU=y
CONFIG_REQUIRES_FULL_LIBCPP=y
CONFIG_MAIN_STACK_SIZE=4096
```

## src/main.cpp
```c
#include <zephyr/kernel.h>
#include <zephyr/device.h>
#include <zephyr/devicetree.h>
#include "I2CConnectionZephyr.h"
#include "UC1611s.h"
#include "uc1611s_smoke.h"

#ifndef UC1611S_I2C_NODE
#define UC1611S_I2C_NODE DT_NODELABEL(i2c0)
#endif
#ifndef UC1611S_ADDR
#define UC1611S_ADDR 0x38
#endif

static int passed = 0;
static int failed = 0;

static void report(const char* label, bool ok) {
    if (ok) { printk("PASS %s\n", label); passed++; }
    else    { printk("FAIL %s\n", label); failed++; }
}

int main(void) {
    const struct device *dev = DEVICE_DT_GET(UC1611S_I2C_NODE);
    I2CConnectionZephyr cmdConn(dev, UC1611S_ADDR);
    I2CConnectionZephyr dataConn(dev, UC1611S_ADDR + 1);
    static UC1611sFull chip(cmdConn, dataConn);
    uc1611sChecks(chip, report);

    printk("===DONE: %d passed, %d failed===\n", passed, failed);
    return 0;
}
```
